## boards/shields/k37/Kconfig.defconfig
```kconfig
# Copyright (c) 2020 The ZMK Contributors
# SPDX-License-Identifier: MIT

if SHIELD_K37

config ZMK_KEYBOARD_NAME
    default "k37 ~ Keyboard"

endif
```

## boards/shields/k37/Kconfig.shield
```kconfig
 #
 # Copyright (c) 2020 The ZMK Contributors
 #
 # SPDX-License-Identifier: MIT
 #

config SHIELD_K37
    def_bool $(shields_list_contains,k37)
```
